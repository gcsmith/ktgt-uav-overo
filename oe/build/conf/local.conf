## oe/build/conf/local.conf
```bitbake
DISTRO = "angstrom-2008.1"
DISTRO_TYPE = "release"
CE_VERSION = "latest"

# Uncomment the line below if you want uclibc instead of glibc
# be prepared for a lot of package breakage!
#ANGSTROM_MODE = "uclibc"

# If you enable glibc and encounter qemu-native build issues
# uncomment the line below.
ENABLE_BINARY_LOCALE_GENERATION=0

PREFERRED_VERSION_libgles-omap3 = "3.01.00.06"
PREFERRED_VERSION_omap3-sgx-modules = "1.4.14.2616"
PREFERRED_VERSION_linux-omap3 = "2.6.33"
```
